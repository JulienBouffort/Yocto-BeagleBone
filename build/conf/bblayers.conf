## build/conf/bblayers.conf
```bitbake
POKY_BBLAYERS_CONF_VERSION = "2"
BBPATH = "${TOPDIR}"
BBFILES ?= ""

BBLAYERS ?= " \
  /home/yocto/sources/poky/meta \
  /home/yocto/sources/poky/meta-poky \
  /home/yocto/sources/poky/meta-yocto-bsp \
  /home/yocto/sources/meta-arm/meta-arm \
  /home/yocto/sources/meta-arm/meta-arm-toolchain \
  /home/yocto/sources/meta-openembedded/meta-oe \
  /home/yocto/sources/meta-openembedded/meta-python \
  /home/yocto/sources/meta-openembedded/meta-networking \
  /home/yocto/sources/meta-ti/meta-ti-bsp \
  /home/yocto/sources/meta-wfb-ng \
  "
```

## sources/meta-wfb-ng/conf/layer.conf
```bitbake
BBPATH .= ":${LAYERDIR}"
BBFILES += "${LAYERDIR}/recipes-*/*/*.bb \
             ${LAYERDIR}/recipes-*/*/*.bbappend"

BBFILE_COLLECTIONS += "wfb-ng"
BBFILE_PATTERN_wfb-ng = "^${LAYERDIR}/"
BBFILE_PRIORITY_wfb-ng = "10"

LAYERDEPENDS_wfb-ng = "core"
LAYERSERIES_COMPAT_wfb-ng = "scarthgap"
```
